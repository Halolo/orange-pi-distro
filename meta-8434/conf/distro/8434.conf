## meta-8434/conf/distro/8434.conf
```bitbake
DISTRO = "8434"

PACKAGE_CLASSES = "package_ipk"

PREFERRED_PROVIDER_virtual/kernel = "linux-8434"
PREFERRED_VERSION_linux-yocto = "4.13%"
```

## meta-8434/conf/layer.conf
```bitbake
# We have a conf and classes directory, append to BBPATH
BBPATH .= ":${LAYERDIR}"

# We have a recipes directory, add to BBFILES
BBFILES += "${LAYERDIR}/recipes*/*/*.bb ${LAYERDIR}/recipes*/*/*.bbappend"

BBFILE_COLLECTIONS += "meta-8434"
BBFILE_PATTERN_meta-8434 := "^${LAYERDIR}/"
BBFILE_PRIORITY_meta-8434 = "10"
```

## meta-opi/conf/distro/opi.conf
```bitbake
DISTRO = "opi"

PACKAGE_CLASSES = "package_ipk"

DISTRO_NAME = "halolo-opi"

DISTRO_FEATURES_append = " ext2 alsa systemd"

DISTRO_FEATURES_append_orange-pi-zero = " wifi"
DISTRO_FEATURES_append_orange-pi-pc = " x11 opengl"
DISTRO_FEATURES_append_orange-pi-pc-plus = " wifi"

VIRTUAL-RUNTIME_init_manager = "systemd"
DISTRO_FEATURES_BACKFILL_CONSIDERED = "sysvinit"
VIRTUAL-RUNTIME_initscripts = ""
```

## meta-opi/conf/layer.conf
```bitbake
# We have a conf and classes directory, append to BBPATH
BBPATH .= ":${LAYERDIR}"

# We have a recipes directory, add to BBFILES
BBFILES += "${LAYERDIR}/recipes*/*/*.bb ${LAYERDIR}/recipes*/*/*.bbappend"

# Machine-specific 'layer'
BBFILES += "${LAYERDIR}/${MACHINE}/recipes*/*/*.bb ${LAYERDIR}/${MACHINE}/recipes*/*/*.bbappend"

BBFILE_COLLECTIONS += "meta-opi"
BBFILE_PATTERN_meta-opi := "^${LAYERDIR}/"
BBFILE_PRIORITY_meta-opi = "10"
```

## meta-opi/conf/machine/include/sun8i.inc
```bitbake
require conf/machine/include/tune-cortexa7.inc

SOC_FAMILY ??= ""
include conf/machine/include/soc-family.inc

# Sub-architecture support
MACHINE_SOCARCH_SUFFIX ?= ""

PREFERRED_PROVIDER_virtual/xserver = "xserver-xorg"
XSERVER = "xserver-xorg \
           xserver-xorg-module-exa \ 
           xf86-video-armsoc \
	   xf86-input-evdev \
           xf86-input-mouse \
           xf86-input-keyboard"

PREFERRED_PROVIDER_virtual/kernel = "linux-opi"
PREFERRED_PROVIDER_u-boot = "u-boot-opi"
PREFERRED_PROVIDER_virtual/bootloader = "u-boot-opi"

KERNEL_IMAGETYPE ?= "uImage"

IMAGE_FSTYPES += "ext4 tar.gz"

MACHINE_EXTRA_RRECOMMENDS = "kernel-modules"

UBOOT_LOCALVERSION = "-g${@d.getVar('SRCPV', True).partition('+')[2][0:7]}"

UBOOT_ENTRYPOINT ?= "0x40008000"
UBOOT_LOADADDRESS ?= "0x400080OB00"

SERIAL_CONSOLE ?= "115200 ttyS0"
MACHINE_FEATURES ?= "alsa apm keyboard rtc serial screen usbgadget usbhost vfat"

PREFERRED_PROVIDER_virtual/mesa = "mesa-gl"
PREFERRED_PROVIDER_virtual/libgl = "mesa-gl"
PREFERRED_PROVIDER_virtual/libgles1 = "mali-blobs"
PREFERRED_PROVIDER_virtual/libgles2 = "mali-blobs"
PREFERRED_PROVIDER_virtual/libegl = "mali-blobs"
PREFERRED_PROVIDER_virtual/egl = "mali-blobs"

XSERVER += "mali-blobs"

MACHINE_ESSENTIAL_EddXTRA_RRECOMMENDS += " \
  mali \
"

SOC_FAMILY = "sun8i"
```

## meta-opi/conf/machine/orange-pi-pc-plus.conf
```bitbake
#@TYPE: Machine
#@NAME: orange-pi-pc-plus
#@DESCRIPTION: Machine configuration for the orange-pi-pc-plus, base on allwinner H3 CPU

require conf/machine/include/sun8i.inc

PREFERRED_VERSION_u-boot = "v2017.03%"

KERNEL_DEVICETREE = "sun8i-h3-orangepi-pc-plus.dtb"
UBOOT_MACHINE = "orangepi_pc_plus_defconfig"

DEFAULTTUNE = "cortexa7hf-neon-vfpv4"
```

## meta-opi/conf/machine/orange-pi-pc.conf
```bitbake
#@TYPE: Machine
#@NAME: orange-pi-pc
#@DESCRIPTION: Machine configuration for the orange-pi-pc, base on allwinner H3 CPU

require conf/machine/include/sun8i.inc

MACHINE_FEATURES += "ext2 vfat"

KERNEL_DEVICETREE = "sun8i-h3-orangepi-pc.dtb"
UBOOT_MACHINE = "orangepi_pc_defconfig"

DEFAULTTUNE = "cortexa7hf-neon-vfpv4"
```

## meta-opi/conf/machine/orange-pi-zero.conf
```bitbake
#@TYPE: Machine
#@NAME: orange-pi-one
#@DESCRIPTION: Machine configuration for the orange-pi-one, base on allwinner H3 CPU

require conf/machine/include/sun8i.inc

KERNEL_DEVICETREE = "sun8i-h2-plus-orangepi-zero.dtb"
UBOOT_MACHINE = "orangepi_zero_defconfig"

DEFAULTTUNE = "cortexa7hf-neon-vfpv4"
```

## meta-opiz/conf/distro/opiz.conf
```bitbake
DISTRO = "opiz"

PACKAGE_CLASSES = "package_ipk"

PREFERRED_PROVIDER_virtual/kernel = "linux-opiz"
PREFERRED_VERSION_linux-yocto = "4.13%"
```
